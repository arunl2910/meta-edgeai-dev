## conf/layer.conf
```bitbake
BBPATH .= ":${LAYERDIR}"

BBFILES += "${LAYERDIR}/recipes-*/*/*.bb \
            ${LAYERDIR}/recipes-*/*/*.bbappend"

BBFILE_COLLECTIONS += "rdke-edgeai"
BBFILE_PATTERN_rdke-edgeai = "^${LAYERDIR}/"
BBFILE_PRIORITY_rdke-edgeai = "10"

LAYERDEPENDS_rdke-edgeai = "core"
LAYERSERIES_COMPAT_rdke-edgeai = "kirkstone"
```
